//modbus.c
#include "modbus.h"

 
u8	modbus_slave_addr=1;		//从机地址
u8	modbus_Tx_buff[100];		//发送缓冲区
u16 modbus_virtual_register[10]={1,2,3,4,5,6,7,8,9,0}; //虚拟寄存器
u8 	modbus_time_ms;
void USART3_IRQHandler(void)
{
	u8 res;
	if(USART_GetITStatus(USART3, USART_IT_RXNE) != RESET)//接收到数据
	{	 
		res =USART3->DR;
		if((USART3_RX_STA&0x8000)==0)//接收未完成
		{
			modbus_time_ms = 0;
			USART3_RX_BUF[USART3_RX_STA&0X3FFF]=res ;
			USART3_RX_STA++;
			if(USART3_RX_STA>(USART3_MAX_SEND_LEN-1)) //接收数据错误,重新开始接收	  
				USART3_RX_STA=0;
		}
	}		
}


//void TIM2_IRQHandler(void)
//{ 	
//	if (TIM_GetITStatus(TIM2, TIM_IT_Update) != RESET)//是更新中断
//	{	 			   
//		TIM_ClearITPendingBit(TIM2, TIM_IT_Update  );  //清除TIMx更新中断标志
//		modbus_time_ms++;
//		if(modbus_time_ms>15) modbus_time_ms=15;
//		if(modbus_time_ms >10 && ((USART3_RX_STA&0X3FFF) !=0))
//		{
//			USART3_RX_STA|=0x8000;
//		}
//	}  
//}
 
/* 发送数据函数，buff为发送内容，len表示发送字节数 */
void modbus_send_data(u8 *buff,u8 len)
{
	Usart_SendStrLen(USART3,buff,len);
}
 
 
/* modbus服务函数 */
void modbus_service(void)
{
	u16 data_CRC_value;   		//从机收到的CRC校验码
	u16 data_len;         		//从机收到的modbus数据长度
	u16 CRC_check_result; 		//从机根据收到的数据计算出来的CRC校验码
	if(USART3_RX_STA&0x8000)   //串口接收完成的标志
	{
		
		data_len = USART3_RX_STA & 0x3fff ; 	
		
		CRC_check_result = CRC16(USART3_RX_BUF,data_len-2);
		data_CRC_value= USART3_RX_BUF[data_len-1]<<8 | (((u16)USART3_RX_BUF[data_len-2])); //对于CRC的接收，先接收低位，再接收高位
		
//		modbus_send_data(USART3_RX_BUF,data_len);
		if(CRC_check_result==data_CRC_value)
		{
			if(USART3_RX_BUF[0]==modbus_slave_addr)
			{
				switch(USART3_RX_BUF[1])
				{
					case 03:     //读多个寄存器
					{
						modbus_03_function();
						break;
					}
					case 06:      //写单个寄存器
					{
						modbus_06_function();
						break;
					}
					case 16:      //写多个寄存器
					{
						modbus_16_function();
						break;
					}
 
				}
			}
		}
		USART3_RX_STA=0;  //开始下一次接收
	}
}
 
 
 
void modbus_03_function(void)
{
	u16 i;
	u16 arr_start=3;   			//从机回复寄存器的值是从数组的第3位开始
	u16 register_len; 		 	//查询寄存器的数量
	u16 register_start;		 	//查询寄存器的起始地址
	modbus_Tx_buff[0] = modbus_slave_addr;
	modbus_Tx_buff[1] = 03;
	register_len = USART3_RX_BUF[5]|(((u16)USART3_RX_BUF[4])<<8); 
	modbus_Tx_buff[2] = register_len * 2;
	register_start = USART3_RX_BUF[3]|(((u16)USART3_RX_BUF[2])<<8);
	for(i=0 ; register_len >i ; i++,register_start++)
	{
		modbus_Tx_buff[arr_start]=modbus_virtual_register[register_start]>>8&0xFF;         
		arr_start++;
		modbus_Tx_buff[arr_start]=modbus_virtual_register[register_start]&0xFF;
		arr_start++;
	}
	arr_start=CRC16(modbus_Tx_buff,register_start*2+3);
	modbus_Tx_buff[register_start*2+3]=(arr_start)&0xFF;         
	modbus_Tx_buff[register_start*2+4]=(arr_start>>8)&0xFF;
	modbus_send_data(modbus_Tx_buff,register_start*2+5);
}
 
 
 
void modbus_06_function(void)
{
	u16 register_addr;				//主机想要修改从机的指定寄存器编号
	
	modbus_Tx_buff[0]=USART3_RX_BUF[0];
	modbus_Tx_buff[1]=USART3_RX_BUF[1];
	modbus_Tx_buff[2]=USART3_RX_BUF[2];
	modbus_Tx_buff[3]=USART3_RX_BUF[3];
	modbus_Tx_buff[4]=USART3_RX_BUF[4];
	modbus_Tx_buff[5]=USART3_RX_BUF[5];
	
	register_addr = USART3_RX_BUF[3]|(((u16)USART3_RX_BUF[2])<<8);
	modbus_virtual_register[register_addr] = USART3_RX_BUF[5]|(((u16)USART3_RX_BUF[4])<<8);
	
	register_addr=CRC16(modbus_Tx_buff,6);
	modbus_Tx_buff[6]=(register_addr)&0xFF;
	modbus_Tx_buff[7]=(register_addr>>8)&0xFF;
	
	modbus_send_data(modbus_Tx_buff,8);
}
 
 
void modbus_16_function(void)
{
	u16 i;
	u16 register_start;	   //修改寄存器的起始地址
	u16 register_num;		   //修改寄存器的数量
	u16 CRC_check_result;  //CRC校验的结果
	modbus_Tx_buff[0]=USART3_RX_BUF[0];
	modbus_Tx_buff[1]=USART3_RX_BUF[1];
	modbus_Tx_buff[2]=USART3_RX_BUF[2];
	modbus_Tx_buff[3]=USART3_RX_BUF[3];
	modbus_Tx_buff[4]=USART3_RX_BUF[4];
	modbus_Tx_buff[5]=USART3_RX_BUF[5];
	CRC_check_result=CRC16(modbus_Tx_buff,6);
	modbus_Tx_buff[6]=(CRC_check_result)&0xFF;
	modbus_Tx_buff[7]=(CRC_check_result>>8)&0xFF;
	
	register_start = USART3_RX_BUF[3]|(((u16)USART3_RX_BUF[2])<<8);  
	register_num = USART3_RX_BUF[5]|(((u16)USART3_RX_BUF[4])<<8);  
	for( i =0;i<register_num;i++)
	{
		modbus_virtual_register[register_start+i] = USART3_RX_BUF[8+i*2]|(((u16)USART3_RX_BUF[7+i*2])<<8);
	}
	modbus_send_data(modbus_Tx_buff,8);
	
}
 
unsigned int CRC16(unsigned char *puchMsg,  unsigned char usDataLen)/* 函数以 unsigned short 类型返回 CRC */
/* puchMsg 用于计算 CRC 的报文 */
/* usDataLen 报文中的字节数 */
{ 
 
	unsigned char uchCRCHi = 0xFF ; /* CRC 的高字节初始化 */
	unsigned char uchCRCLo = 0xFF ; /* CRC 的低字节初始化 */
	unsigned short int uIndex ; /* CRC 查询表索引 */
  unsigned char auchCRCHi[] = { 
		0x00, 0xC1, 0x81, 0x40, 0x01, 0xC0, 0x80, 0x41, 0x01, 0xC0, 0x80, 0x41,
		0x00, 0xC1, 0x81,
		0x40, 0x01, 0xC0, 0x80, 0x41, 0x00, 0xC1, 0x81, 0x40, 0x00, 0xC1, 0x81,
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		0x00, 0xC1, 0x81,
		0x40
    } ;  
	unsigned char auchCRCLo[] = {  
		0x00, 0xC0, 0xC1, 0x01, 0xC3, 0x03, 0x02, 0xC2, 0xC6, 0x06, 0x07, 0xC7,
		0x05, 0xC5, 0xC4,
		0x04, 0xCC, 0x0C, 0x0D, 0xCD, 0x0F, 0xCF, 0xCE, 0x0E, 0x0A, 0xCA, 0xCB,
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		0x41, 0x81, 0x80,
		0x40
    } ;
 
   while (usDataLen--) /* 完成整个报文缓冲区 */
	{
		uIndex = uchCRCLo ^ *puchMsg++ ; /* 计算 CRC */
		uchCRCLo = uchCRCHi ^ auchCRCHi[uIndex] ;
		uchCRCHi = auchCRCLo[uIndex] ;
	}
	return (uchCRCHi << 8 | uchCRCLo) ;
}
 
 
 
 

 